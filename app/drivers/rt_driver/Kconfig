## boards/my_dev_board/Kconfig.defconfig
```kconfig
# STM32F767ZI Nucleo board configuration

# Copyright (c) 2019 Roland Ma
# SPDX-License-Identifier: Apache-2.0

if BOARD_MY_DEV_BOARD

configdefault NET_L2_ETHERNET
	default y

endif # BOARD_MY_DEV_BOARD
```

## boards/my_dev_board/Kconfig.my_dev_board
```kconfig
# Copyright (c) 2019 Roland Ma
# SPDX-License-Identifier: Apache-2.0

config BOARD_MY_DEV_BOARD
	select SOC_STM32F767XX
```

## boards/my_dev_board/board.yml
```yaml
board:
  name: my_dev_board
  full_name: My development board
  vendor: rt
  socs:
    - name: stm32f767xx
```

## boards/my_nucleo/Kconfig.my_nucleo
```kconfig
# Copyright (c) 2019 Roland Ma
# SPDX-License-Identifier: Apache-2.0

config BOARD_MY_NUCLEO
	select SOC_STM32F767XX
```

## boards/my_nucleo/board.yml
```yaml
board:
  name: my_nucleo
  full_name: My Nucleo F767ZI development board
  vendor: rt
  socs:
    - name: stm32f767xx
```

## boards/sam3u4e_ek/Kconfig.defconfig
```kconfig
# SAM3U4E-EK board configuration

# Copyright (c) 2026
# SPDX-License-Identifier: Apache-2.0

if BOARD_SAM3U4E_EK

config GPIO
	default y

config CONSOLE
	default n

endif # BOARD_SAM3U4E_EK
```

## boards/sam3u4e_ek/Kconfig.sam3u4e_ek
```kconfig
# Copyright (c) 2026
# SPDX-License-Identifier: Apache-2.0

config BOARD_SAM3U4E_EK
	select SOC_SAM3U4E
```

## boards/sam3u4e_ek/board.yml
```yaml
board:
  name: sam3u4e_ek
  full_name: Atmel SAM3U4E Evaluation Kit
  vendor: atmel
  socs:
    - name: sam3u4e
```

## west.yml
```yaml
manifest:
  version: 1.0

  projects:
    - name: zephyr
      url: https://github.com/zephyrproject-rtos/zephyr
      revision: v4.4.2
      import:
        name-allowlist:
          - cmsis_6
          - hal_stm32
          - hal_espressif
        path-prefix: deps
```
